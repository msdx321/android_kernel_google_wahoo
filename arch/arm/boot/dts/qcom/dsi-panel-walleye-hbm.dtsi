&mdss_mdp {
	mdss_dsi_samsung_s6e3fa5_1080p_cmd: htc,mdss_dsi_samsung_s6e3fa5_1080p_cmd {
		compatible = "htc,mdss_dsi_samsung_s6e3fa5_1080p_cmd";
		qcom,mdss-dsi-hbm-on-command = [
			15 01 00 00 00 00 02 53 E0];
		qcom,mdss-dsi-hbm-off-command = [
			15 01 00 00 00 00 02 53 20];
	};
};
